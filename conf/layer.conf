## conf/layer.conf
```bitbake
# We have a conf and classes directory, add to BBPATH
BBPATH .= ":${LAYERDIR}"

# We have recipes-* directories, add to BBFILES
BBFILES += "${LAYERDIR}/recipes-*/*/*.bb \
            ${LAYERDIR}/recipes-*/*/*.bbappend"

BBFILE_COLLECTIONS += "my_layer1"
BBFILE_PATTERN_my_layer1 = "^${LAYERDIR}/"
BBFILE_PRIORITY_my_layer1 = "6"

LAYERDEPENDS_my_layer1 = "core"
LAYERSERIES_COMPAT_my_layer1 = "kirkstone"
```
